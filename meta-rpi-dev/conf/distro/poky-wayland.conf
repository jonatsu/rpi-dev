## meta-rpi-dev/conf/distro/poky-wayland.conf
```bitbake
# Test distro based on Poky.
# Based on: https://github.com/Igalia/meta-wpe-image/blob/7e7fd10a67de7a046b89838cb26c0d8d27571f39/conf/distro/poky-wayland.conf
require conf/distro/poky-altcfg.conf

DISTRO = "poky-wayland"
DISTRO_NAME = "Poky Wayland"
DISTRO_VERSION = "1.0"
DISTRO_CODENAME = "poky-wayland"

DISTROOVERRIDES = "poky:poky-altcfg:linuxstdbase"

DISTRO_FEATURES:append = " egl \
                           opengl \
                           pam \
                           polkit \
                           pulseaudio \
                           wayland \
                           systemd \
                         "

#DISTRO_FEATURES:remove = "ptest"

# See: https://docs.yoctoproject.org/scarthgap/ref-manual/classes.html#ref-classes-package
PACKAGE_CLASSES ?= "package_ipk"
# EXTRA_IMAGE_FEATURES:append = " package-management"

IMAGE_INSTALL:append = " nano"

# Use 'udev' for device management.
# https://docs.yoctoproject.org/scarthgap/dev-manual/device-manager.html
VIRTUAL-RUNTIME_dev_manager = "udev"

# Enable 'systemd' as the init manager.
# https://docs.yoctoproject.org/scarthgap/dev-manual/init-manager.html
# https://docs.yoctoproject.org/scarthgap/ref-manual/variables.html#term-DISTRO_FEATURES_BACKFILL_CONSIDERED
INIT_MANAGER = "systemd"
DISTRO_FEATURES_BACKFILL_CONSIDERED += "sysvinit"
VIRTUAL-RUNTIME_initscripts = "systemd-compat-units"
VIRTUAL-RUNTIME_syslog = ""
VIRTUAL-RUNTIME_base-utils-syslog = ""

# Add build information in the image (/etc/buildinfo)
INHERIT += "image-buildinfo"
IMAGE_BUILDINFO_VARS:append = " DATETIME DISTRO_NAME IMAGE_BASENAME MACHINE TUNE_PKGARCH"
IMAGE_BUILDINFO_VARS:append = " MACHINE_FEATURES DISTRO_FEATURES COMMON_FEATURES IMAGE_FEATURES"
IMAGE_BUILDINFO_VARS:append = " TUNE_FEATURES TARGET_FPU"

# GStreamer Video decoder
# * v4l2h264dec (by default):
# PACKAGECONFIG:append:pn-gstreamer1.0-plugins-bad = " v4l2codecs"
# * GstOMXH264Dec (only software acceleration available for VC4):
# IMAGE_INSTALL:append = " gstreamer1.0-omx"
```

## meta-rpi-dev/conf/machine/raspberrypi5-extra.conf
```bitbake
#@TYPE: Machine
#@NAME: RaspberryPi 5 Development Board (64bit)
#@DESCRIPTION: Machine configuration for the RaspberryPi 5 in 64 bits mode

MACHINEOVERRIDES =. "raspberrypi5:"
#require conf/machine/raspberrypi5.conf

#PREFERRED_VERSION_linux-raspberrypi ??= "6.12.%"
#PREFERRED_VERSION_linux-raspberrypi-v7 ??= "${PREFERRED_VERSION_linux-raspberrypi}"

MACHINE_EXTRA_RRECOMMENDS += "\
    rpi-config \
    rpi-eeprom \
    raspi-utils \
    u-boot-env \
    u-boot-fw-utils \
"
```
